#include <Adafruit_GFX.h>
#include <Adafruit_ST7789.h>
#include <SPI.h>
#include <ArduinoJson.h>
#include <WiFi.h>
#include <HTTPClient.h>

Adafruit_ST7789 tft = Adafruit_ST7789(TFT_CS, TFT_DC, TFT_RST);


WiFiClient client; // wifi client object

const char* host         = "192.168.0.1";
// uncomment for second host
//const char* host2        = "192.168.0.2";
const char* ssid         = "SSIS";
const char* password     = "PASS";

static uint16_t background[] = {2043,2043,2043,2043,2043,2043,2043,2043,2043,2043,2043,2043,2043,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2043,
2043,2043,2043,2043,2043,2043,2043,2043,2043,2043,2043,2043,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2043,
2043,2043,51200,51200,51200,51200,51200,51200,51200,51200,51200,51200,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2043,
2043,2043,51200,51200,51200,51200,51200,51200,51200,51200,51200,51200,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2043,
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2043,2043,52800,52800,52800,52800,52800,52800,52800,52800,52800,52800,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2043,
2043,2043,52800,52800,52800,52800,52800,52800,52800,52800,52800,52800,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2043,
2043,2043,2043,2043,2043,2043,2043,2043,2043,2043,2043,2043,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2043,
2043,2043,2043,2043,2043,2043,2043,2043,2043,2043,2043,2043,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2043,};

void setup() {
  Serial.begin(115200);

  // turn on backlite
  pinMode(TFT_BACKLITE, OUTPUT);
  digitalWrite(TFT_BACKLITE, HIGH);

  // turn on the TFT / I2C power supply
  pinMode(TFT_I2C_POWER, OUTPUT);
  digitalWrite(TFT_I2C_POWER, HIGH);
  delay(10);

  // initialize TFT
  tft.init(135, 240); // Init ST7789 240x135
  tft.setRotation(3);
  tft.fillScreen(ST77XX_BLACK);

  tft.println(F("Initialized"));
    for(uint8_t t = 4; t > 0; t--) {
        tft.printf("[SETUP] WAIT %d...\n", t);
        delay(1000);
    }
  Start_WiFi(ssid,password);
}

void loop() {
  tft.drawRGBBitmap(0, 0, background, 240, 135);

   if((WiFi.status() == WL_CONNECTED)) {
    HTTPClient http;
    //HTTPClient http2;
    
    Serial.print("[HTTP] begin...\n");
    http.begin("http://"+ String(host) +"/admin/api.php"); //HTTP
    //http2.begin("http://"+ String(host2) +"/admin/api.php"); //HTTP)

    int httpCode = http.GET();
    //int httpCode2 = http2.GET();

    if(httpCode > 0) {
        Serial.printf("[HTTP] GET... code: %d\n", httpCode);
        if(httpCode == HTTP_CODE_OK) {
            String payload = http.getString();
            //String payload2 = http2.getString();         
            Serial.println(payload);

            DynamicJsonDocument doc(2048);
            //DynamicJsonDocument doc2(2048);
            DeserializationError error = deserializeJson(doc, payload);
            //DeserializationError error2 = deserializeJson(doc2, payload2);

      if (error) {
        Serial.print("deserializeJson() failed: ");
        Serial.println(error.c_str());
        return;
      }
            long domains_being_blocked = doc["domains_being_blocked"]; // 101832
            long dns_queries_today = doc["dns_queries_today"]; // 186369
            int ads_blocked_today = doc["ads_blocked_today"]; // 11336
            float ads_percentage_today = doc["ads_percentage_today"]; // 6.082557

            // long dns_queries_today2 = doc2["dns_queries_today"]; // 186369
            // int ads_blocked_today2 = doc2["ads_blocked_today"]; // 11336
            // float ads_percentage_today2 = doc2["ads_percentage_today"]; // 6.082557

            tft.setCursor(4, 5);
            tft.setTextSize(1);
            tft.println("DNS Queries Today: ");
            tft.setCursor(4, 14);
            tft.setTextSize(2); 
            tft.println(String(dns_queries_today));
            //tft.setCursor(4, 30);
            //tft.println(String(dns_queries_today2));
            // 
            tft.setCursor(125, 5);
            tft.setTextSize(1);
            tft.println("Ads Blocked Today: ");
            tft.setCursor(125, 14);
            tft.setTextSize(2); 
            tft.println(String(ads_blocked_today));
            //tft.setCursor(125, 30);
            //tft.println(String(ads_blocked_today2));
            //
            tft.setCursor(4, 72);
            tft.setTextSize(1);   
            tft.println("Domains Blocked: ");
            tft.setCursor(4, 82);
            tft.setTextSize(2); 
            tft.println(String(domains_being_blocked));
            //
            tft.setCursor(125, 72);
            tft.setTextSize(1);    
            tft.println("Percentage of Ads: ");
            tft.setCursor(125, 82);
            tft.setTextSize(2); 
            tft.println(String(ads_percentage_today) + "%");
            //tft.setCursor(125, 98);
            //tft.println(String(ads_percentage_today2) + "%");
            //
        }
        } else {
            Serial.printf("[HTTP] GET... failed, error: %s\n", http.errorToString(httpCode).c_str());
            tft.println("Cant Connect");
       }
    }
        delay(5000);
}

int Start_WiFi(const char* ssid, const char* password){
    int connAttempts = 0;
    Serial.println("\r\nConnecting to: "+String(ssid));
    WiFi.begin(ssid, password);
    while (WiFi.status() != WL_CONNECTED ) {
        delay(500);
        Serial.print(".");
        if(connAttempts > 20) return -5;
        connAttempts++;
        }
    Serial.println("WiFi connected\r\n");
    Serial.print("IP address: ");
    Serial.println(WiFi.localIP());
    return 1;
}


